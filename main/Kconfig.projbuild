## main/Kconfig.projbuild
```kconfig
menu "TheLink"

    config THELINK_TZ
        string "Default timezone (POSIX)"
        default ""
        help
            Timezone used to render local time in evt/status, as a POSIX TZ
            string. Leave empty to report UTC only, with no local time.

            This is NOT an IANA name. The C library in this build ships no
            timezone database, so "Asia/Kolkata" resolves to nothing and the
            offset silently stays at zero. Send the POSIX form instead, e.g.
            "IST-5:30".

            Mind the inverted sign: a POSIX offset is the time you ADD to local
            time to reach UTC, so India (UTC+05:30) is -5:30.

            Whatever is set here is only a factory default. A timezone sent to
            cmd/timezone overrides it and is persisted to the SD card, and the
            stored value wins on the next boot.

endmenu

menu "Example Configuration"

    config BROKER_URL
        string "Broker URL"
        default "mqtt://broker.emqx.io"
        help
            URL of the broker to connect to, with a scheme: mqtt:// or mqtts://
            for TLS, ws:// or wss:// over a WebSocket.

            scripts/build.py asks for this at build time along with the
            credentials, and writes the answer to the gitignored
            sdkconfig.secrets. This option stays the source of truth whenever
            that file does not name a broker URL.

    config MQTT_USERNAME
        string "MQTT username"
        default ""
        help
            Username sent to the broker. Leave empty to connect anonymously
            (e.g. a public broker with no authentication).

            scripts/build.py normally asks for this at build time and caches the
            answer in the gitignored sdkconfig.secrets, so it rarely needs to be
            set by hand here. Setting it in menuconfig works too, but the value
            is then written into build*/sdkconfig.

    config MQTT_PASSWORD
        string "MQTT password"
        default ""
        help
            Password sent to the broker. Only meaningful when MQTT_USERNAME is
            set; esp-mqtt omits the password from the CONNECT packet otherwise.

            See MQTT_USERNAME for how this is normally supplied.
    
    choice EXAMPLE_PROV_TRANSPORT
        bool "Provisioning Transport"
        default EXAMPLE_PROV_TRANSPORT_SOFTAP if IDF_TARGET_ESP32S2
        default EXAMPLE_PROV_TRANSPORT_BLE
        help
            Wi-Fi provisioning component offers both, SoftAP and BLE transports. Choose any one.

        config EXAMPLE_PROV_TRANSPORT_BLE
            bool "BLE"
            select BT_ENABLED
            depends on !IDF_TARGET_ESP32S2
        config EXAMPLE_PROV_TRANSPORT_SOFTAP
            bool "Soft AP"
            select LWIP_IPV4
    endchoice

    choice EXAMPLE_PROV_SECURITY_VERSION
        bool "Protocomm security version"
        default EXAMPLE_PROV_SECURITY_VERSION_2
        help
            Wi-Fi provisioning component offers 3 security versions.
            The example offers a choice between security version 1 and 2.

        config EXAMPLE_PROV_SECURITY_VERSION_1
            bool "Security version 1"
            select ESP_PROTOCOMM_SUPPORT_SECURITY_VERSION_1

        config EXAMPLE_PROV_SECURITY_VERSION_2
            bool "Security version 2"
            select ESP_PROTOCOMM_SUPPORT_SECURITY_VERSION_2
    endchoice

    choice EXAMPLE_PROV_MODE
        bool "Security version 2 mode"
        depends on EXAMPLE_PROV_SECURITY_VERSION_2
        default EXAMPLE_PROV_SEC2_DEV_MODE

        config EXAMPLE_PROV_SEC2_DEV_MODE
            bool "Security version 2 development mode"
            depends on EXAMPLE_PROV_SECURITY_VERSION_2
            help
                This enables the development mode for
                security version 2.
                Please note that this mode is NOT recommended for production purpose.

        config EXAMPLE_PROV_SEC2_PROD_MODE
            bool "Security version 2 production mode"
            depends on EXAMPLE_PROV_SECURITY_VERSION_2
            help
                This enables the production mode for
                security version 2.
    endchoice

    config EXAMPLE_PROV_TRANSPORT
        int
        default 1 if EXAMPLE_PROV_TRANSPORT_BLE
        default 2 if EXAMPLE_PROV_TRANSPORT_SOFTAP

    config EXAMPLE_PROV_ENABLE_APP_CALLBACK
        bool "Enable provisioning manager app callback"
        default n
        help
            This is for advanced use-cases like modifying Wi-Fi configuration parameters. This
            executes a blocking app callback when any provisioning event is triggered.

    config EXAMPLE_RESET_PROVISIONED
        bool
        default n
        prompt "Reset provisioned status of the device"
        help
            This erases the NVS to reset provisioned status of the device on every reboot.
            Provisioned status is determined by the Wi-Fi STA configuration, saved on the NVS.

    config EXAMPLE_RESET_PROV_MGR_ON_FAILURE
        bool
        default y
        prompt "Reset provisioned credentials and state machine after session failure"
        help
            Enable resetting provisioned credentials and state machine after session failure.
            This will restart the provisioning service after retries are exhausted.

    config EXAMPLE_PROV_MGR_CONNECTION_CNT
        int
        default 5
        prompt "Max connection attempts before resetting provisioning state machine"
        depends on EXAMPLE_RESET_PROV_MGR_ON_FAILURE
        help
            Set the total number of connection attempts to avoid reconnecting to an inexistent AP or if credentials
            are misconfigured. Provisioned credentials are erased and internal state machine
            is reset after this threshold is reached.

    config EXAMPLE_PROV_SHOW_QR
        bool "Show provisioning QR code"
        default y
        help
            Show the QR code for provisioning.

    config EXAMPLE_PROV_USING_BLUEDROID
        bool
        depends on (BT_BLUEDROID_ENABLED && (IDF_TARGET_ESP32C3 || IDF_TARGET_ESP32S3))
        select BT_BLE_42_FEATURES_SUPPORTED
        default y
        help
            This enables BLE 4.2 features for Bluedroid.

endmenu
```
